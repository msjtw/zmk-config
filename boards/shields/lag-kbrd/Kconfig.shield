## boards/shields/lag-kbrd/Kconfig.shield
```kconfig
config SHIELD_KBRD_LEFT
    def_bool $(shields_list_contains,lag-kbrd_left)

config SHIELD_KBRD_RIGHT
    def_bool $(shields_list_contains,lag-kbrd_right)
```
